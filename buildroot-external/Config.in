## buildroot-external/Config.in
```kconfig
source "$BR2_EXTERNAL_ASYNCOS_PATH/package/asyncos-controller/Config.in"
source "$BR2_EXTERNAL_ASYNCOS_PATH/package/asyncos-kiosk/Config.in"
source "$BR2_EXTERNAL_ASYNCOS_PATH/package/qemu-guest-agent/Config.in"
source "$BR2_EXTERNAL_ASYNCOS_PATH/package/lxd-guest-agent/Config.in"
source "$BR2_EXTERNAL_ASYNCOS_PATH/package/rtl88x2bu/Config.in"
source "$BR2_EXTERNAL_ASYNCOS_PATH/package/tempio/Config.in.host"
source "$BR2_EXTERNAL_ASYNCOS_PATH/package/xe-guest-utilities/Config.in"
```

## buildroot-external/package/asyncos-controller/Config.in
```kconfig
config BR2_PACKAGE_ASYNCOS_CONTROLLER
	bool "AsyncOS controller"
	depends on BR2_PACKAGE_HOST_GO_TARGET_ARCH_SUPPORTS
	depends on BR2_INIT_SYSTEMD
	select BR2_PACKAGE_HOST_GO
	help
	  The AsyncOS PV, genset and export-limit controller: Modbus
	  device polling, the control loop, energy statistics, users
	  and roles, and the web UI on port 80.
```

## buildroot-external/package/asyncos-kiosk/Config.in
```kconfig
config BR2_PACKAGE_ASYNCOS_KIOSK
	bool "AsyncOS kiosk display"
	depends on BR2_PACKAGE_ASYNCOS_CONTROLLER
	depends on BR2_PACKAGE_COG_PLATFORM_DRM
	help
	  Shows the AsyncOS wall display full screen on the device's own
	  monitor, using the WPE WebKit browser (cog) directly on
	  DRM/KMS without a desktop. The controller gives this local
	  screen read-only access without a login.

comment "AsyncOS kiosk needs the AsyncOS controller and cog with the DRM backend"
	depends on !BR2_PACKAGE_ASYNCOS_CONTROLLER || !BR2_PACKAGE_COG_PLATFORM_DRM
```
